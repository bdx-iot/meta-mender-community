## meta-mender-st/conf/layer.conf
```bitbake
# Copyright 2019 Northern.tech AS

# We have a conf and classes directory, add to BBPATH
BBPATH .= ":${LAYERDIR}"

# We have recipes-* directories, add to BBFILES
BBFILES += "${LAYERDIR}/recipes-*/*/*.bb \
	${LAYERDIR}/recipes-*/*/*.bbappend"

BBFILE_COLLECTIONS += "mender-st"
BBFILE_PATTERN_mender-st = "^${LAYERDIR}/"
BBFILE_PRIORITY_mender-st = "10"

LAYERSERIES_COMPAT_mender-st = "thud warrior"
```
